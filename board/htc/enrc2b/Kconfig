## board/htc/enrc2b/Kconfig
```kconfig
if TARGET_ENRC2B

config SYS_BOARD
	default "enrc2b"

config SYS_VENDOR
	default "htc"

config TEGRA_BOARD_STRING
	string "Default Tegra board name"
	default "HTC One X+"

endif
```

## board/nec/ltna7/Kconfig
```kconfig
if TARGET_LTNA7

config SYS_BOARD
	default "ltna7"

config SYS_VENDOR
	default "nec"

config TEGRA_BOARD_STRING
	string "Default Tegra board name"
	default "NEC LifeTouch Note"

endif
```

## board/nvidia/s8515/Kconfig
```kconfig
if TARGET_S8515

config SYS_BOARD
	default "s8515"

config SYS_VENDOR
	default "nvidia"

config TEGRA_BOARD_STRING
	string "Default Tegra board name"
	default "NVIDIA s8515"

config TEGRA_PRAM_SIZE
	depends on TEGRA_PRAM
	default 0x21c00

endif
```

## board/sony/nbx/Kconfig
```kconfig
if TARGET_SONY_NBX

config SYS_BOARD
	default "nbx"

config SYS_VENDOR
	default "sony"

config TEGRA_BOARD_STRING
	string "Default Tegra board name"
	default "Sony Tablet P"

endif
```
